#include "pixels.h"

void pixels_setup(void) {
  int i;
  for (i = 0; i < 12; i++) {
    pinMode(i + 2, OUTPUT);
    digitalWrite(i + 2, LOW);
  }
}

static uint8_t pixel_row[] = { 13, 10, 12, 5, 11, 3, 2 };
static uint8_t pixel_column[] = { 8, 9, 4, 7, 6 };

void pixels_refresh(const uint8_t* pix) {
  int i, j;

  for (j = 0; j < 5; j++) {
    digitalWrite(pixel_column[j], HIGH);
    uint8_t v;
    v = pix[j];
    for (i = 0; i < 7; i++) {
      if (v & 1) {
        digitalWrite(pixel_row[i], v&1 ? LOW : HIGH);
        delayMicroseconds(30);
        digitalWrite(pixel_row[i], HIGH);
      }
      v >>= 1;
    }
    digitalWrite(pixel_column[j], LOW);
  }
}

static uint8_t font[] = {
  0x00, 0x00, 0x00, 0x00, 0x00,  //
  
  0x00, 0x00, 0x7d, 0x00, 0x00,  // !
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  0x08, 0x10, 0x08, 0x04, 0x08,  // ~
};

void pixels_scroll(const char* message, int len, int scroll) {
  uint8_t im[5];

  for (int i = 0; i < 5; i++) {
    int at = scroll + i;
    int pos = (at/ 6) % (len + 2);
    int pos1 = at % 6;
    if (pos1 == 5) {
      im[i] = 0;
    } else {
      if (pos == 0 || pos == len + 1) {
        im[i] = 0;
      } else {
        im[i] = font[(message[pos - 1] - ' ') * 5 + pos1];
      }
    }
  }
  pixels_refresh(im);
}

int pixels_scroll_width(int len) {
  return len * 6 + 6;
}
